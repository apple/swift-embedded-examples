## arduino-esp32-led-blink-sdk/main/Kconfig.projbuild
```kconfig
# put here your custom config value
menu "Example Configuration"
config LED_BLINK_INTERVAL_MS
    int "LED blinking interval / ms"
    default 500
    help
	Interval in milliseconds between turning the LED on/off
endmenu
```

## arduino-esp32-wifi-scan-sdk/main/Kconfig.projbuild
```kconfig
# put here your custom config value
menu "Example Configuration"
config WIFI_SCAN_INTERVAL_MS
    int "WiFi network scanning interval / ms"
    default 5000
    help
	Interval in milliseconds between scanning for networks
endmenu
```

## esp32-ble-peripheral-sdk/sdkconfig.defaults
```kconfig
#
# BT config
#
CONFIG_BT_ENABLED=y
CONFIG_BT_BLUEDROID_ENABLED=n
CONFIG_BT_NIMBLE_ENABLED=y
CONFIG_BT_NIMBLE_HCI_EVT_BUF_SIZE=70
CONFIG_BT_NIMBLE_EXT_ADV=n
```

## nrfx-blink-sdk/west.yml
```yaml
manifest:
  remotes:
    - name: zephyrproject-rtos
      url-base: https://github.com/zephyrproject-rtos

  projects:
    - name: zephyr
      remote: zephyrproject-rtos
      revision: v4.2.2
      import:
        name-allowlist:
          - cmsis_6  # required by the ARM port for Cortex-M
          - hal_nordic  # required by the custom_plank board (Nordic based)
```

## nuttx-riscv-blink/leds_swift/Kconfig
```kconfig
#
# For a description of the syntax of this configuration file,
# see the file kconfig-language.txt in the NuttX tools repository.
#

config EXAMPLES_LEDS_SWIFT
	tristate "\"LEDs Swift\" example"
	default y
	depends on USERLED
	---help---
		Enable the \"LEDs Swift\" example

if EXAMPLES_LEDS_SWIFT

config EXAMPLES_LEDS_SWIFT_PROGNAME
	string "Program name"
	default "leds_swift"
	---help---
		This is the name of the program that will be used when the NSH ELF
		program is installed.

config EXAMPLES_LEDS_SWIFT_PRIORITY
	int "LEDs Swift task priority"
	default 100

config EXAMPLES_LEDS_SWIFT_STACKSIZE
	int "LEDs Swift stack size"
	default DEFAULT_TASK_STACKSIZE

endif
```
